## config/west.yml
```yaml
manifest:
  defaults:
    revision: v0.2
  remotes:
    - name: zmkfirmware
      url-base: https://github.com/zmkfirmware
    - name: cdarwin
      url-base: https://github.com/cdarwin
  projects:
    - name: zmk
      remote: zmkfirmware
      import: app/west.yml
    - name: zmk-ble_chiffre-module
      remote: cdarwin
      revision: main
  self:
    path: config
```
